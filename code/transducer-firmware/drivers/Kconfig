## code/transducer-firmware/drivers/Kconfig
```kconfig
menu "Drivers"
rsource "counter/Kconfig"
rsource "mfd/Kconfig"
rsource "rtc/Kconfig"
rsource "sensor/Kconfig"
endmenu
```

## code/transducer-firmware/drivers/counter/Kconfig.rv3032
```kconfig
config COUNTER_RV3032
	bool "RV-3032 counter driver"
	default y
	depends on DT_HAS_MICROCRYSTAL_RV3032_MFD_ENABLED
	depends on DT_HAS_MICROCRYSTAL_RV3032_COUNTER_ENABLED
	select I2C
    select MFD
	help
	  Enable driver for Microcrystal RV-3032 counter device.

config COUNTER_RV3032_INIT_PRIORITY
	int "RV-3032 counter driver initialization priority"
	depends on COUNTER_RV3032
	default 86
	help
	  Initialization priority for the RV-3032 counter driver. It must be
	  greater than MFD_INIT_PRIORITY.
```

## code/transducer-firmware/drivers/mfd/Kconfig
```kconfig
if MFD

config MFD_INIT_PRIORITY
	int "Initialization priority"
	default 80
	help
	  Multi-function devices initialization priority.

rsource "Kconfig.rv3032"
endif # MFD
```

## code/transducer-firmware/drivers/mfd/Kconfig.rv3032
```kconfig
config MFD_RV3032
	bool "RV-3032 multi-function device driver"
	default y
	depends on DT_HAS_MICROCRYSTAL_RV3032_MFD_ENABLED
	select I2C
	help
	  Enable the Microcrystal RV-3032 multi-function device driver
```

## code/transducer-firmware/drivers/rtc/Kconfig.rv3032
```kconfig
config RTC_RV3032
	bool "RV-3032 RTC driver"
	default y
	depends on DT_HAS_MICROCRYSTAL_RV3032_MFD_ENABLED
	depends on DT_HAS_MICROCRYSTAL_RV3032_RTC_ENABLED
	select I2C
    select MFD
	help
	  Enable RTC driver based on Microcrystal RV-3032 I2C device.

config RTC_RV3032_INIT_PRIORITY
	int "RV-3032 RTC driver initialization priority"
	depends on RTC_RV3032
	default 86
	help
	  Initialization priority for the RV-3032 RTC driver. It must be
	  greater than the I2C controller init priority and the mfd driver
	  init priority.
```

## code/transducer-firmware/drivers/sensor/microcrystal/rv3032/Kconfig
```kconfig
config SENSOR_RV3032
	bool "RV-3032 sensor"
	default y
	depends on DT_HAS_MICROCRYSTAL_RV3032_MFD_ENABLED
	depends on DT_HAS_MICROCRYSTAL_RV3032_SENSOR_ENABLED
	select I2C
	select MFD
	select RTIO_WORKQ if SENSOR_ASYNC_API
	help
	  Enable driver for RV-3032 I2C-based temperature sensor.

config SENSOR_RV3032_INIT_PRIORITY
	int "RV-3032 sensor driver init priority"
    depends on SENSOR_RV3032
	default 86
	help
      Init priority for the RV-3032 sensor driver. It must be
      greater than MFD_INIT_PRIORITY.
```

## code/transducer-firmware/dts/bindings/mfd/microcrystal,rv3032-mfd.yaml
```yaml
description: |
  Microcrystal RV-3032 I2C MFD

  The following example displays the node layout
  with every possible partial driver included.

  rv3032: rv3032@51 {
          compatible = "microcrystal,rv3032-mfd";
          reg = <0x51>;
          backup-switch-mode = "level";
          trickle-resistor-ohms = 600;
          trickle-charger-mode = "3.00V";
          int-gpios = <&gpio0 4 (GPIO_PULL_UP | GPIO_ACTIVE_LOW)>;

          rv3032_sensor: rv3032-sensor {
                  compatible = "microcrystal,rv3032-sensor";
                  status = "okay";
          };

          rv3032_rtc: rv3032-rtc {
                  compatible = "microcrystal,rv3032-rtc";
                  status = "okay";
          };
  };

compatible: "microcrystal,rv3032-mfd"

include: [i2c-device.yaml]

properties:
  backup-switch-mode:
    type: string
    required: true
    enum:
      - "disabled"
      - "direct"
      - "level"
    description: |
      Automatic backup switchover function selection:
        - disabled: The switchover function is disabled - only one power supply available (VDD)
        - direct: Direct Switching Mode (DSM): when VDD < VBACKUP, switchover occurs from VDD to
          VBACKUP without requiring VDD to drop below VTH:LSM (2.0 V)
        - level: Level Switching Mode (LSM): when VDD < VTH:LSM (2.0 V) AND VBACKUP > VTH:LSM,
          switchover occurs from VDD to VBACKUP

  trickle-resistor-ohms:
    type: int
    enum:
      - 600
      - 2000
      - 7000
      - 12000
    description: |
      Trickle charger series resistance.

  trickle-charger-mode:
    type: string
    enum:
      - "off"
      - "1.75V"
      - "3.00V"
      - "4.50V"
    description: |
      Charge pump voltage for trickle charger, if enabled.

  int-gpios:
    type: phandle-array
    description: |
      GPIO connected to the RV3032 INT interrupt output. This signal is open-drain, active low.
```

## code/transducer-firmware/dts/bindings/rtc/microcrystal,rv3032-rtc.yaml
```yaml
description: Microcrystal RV-3032 I2C real time clock

compatible: "microcrystal,rv3032-rtc"

include: [rtc-device.yaml]

# properties:
  # clkout-frequency:
  #   type: int
  #   enum:
  #     - 32768
  #     - 8192
  #     - 1024
  #     - 64
  #     - 32
  #     - 1
  #   description: |
  #     Frequency of the CLKOUT signal in Hertz (Hz). If omitted, the CLKOUT pin is LOW.

# dependencies:
#   trickle-resistor-ohms: ["trickle-charger-mode"]
#   trickle-charger-mode: ["trickle-resistor-ohms"]
# allOf:
#   - if:
#       required: ["trickle-resistor-ohms"]
#     then:
#       required: ["trickle-charger-mode"]
#   - if:
#       required: ["trickle-charger-mode"]
#     then:
#       required: ["trickle-resistor-ohms"]
```

## code/transducer-firmware/dts/bindings/sensor/microcrystal,rv3032-sensor.yaml
```yaml
description: Microcrystal RV-3032 I2C temperature sensor 

compatible: "microcrystal,rv3032-sensor"

include: [sensor-device.yaml]
```

## code/transducer-firmware/main/Kconfig
```kconfig
menu "Transducer Firmware"
    # choice TRANSDUCER_HARDWARE_TARGET
    #     prompt "Hardware Target"
    #     default DIY3
    #     help
    #         Hardware target to use when compiling firmware.

    #     config DIY3
    #         bool "DIY3"
    #     config DIY4
    #         bool "DIY4"
    #     config DIY5
    #         bool "DIY5"
    # endchoice

    config TRANSDUCER_ULP_TOGGLE_GPIO
        bool "Toggle GPIO on ULP program start/stop"
        default "n"
        help
            Add ULP program instructions that will toggle GPIO_NUM_4 when the
            ULP program starts and stops. This is useful when debugging for
            verifying the sampling frequency using a scope.
endmenu
```

## code/transducer-firmware/sdkconfig.defaults
```kconfig
#
# Serial flasher config
#
CONFIG_ESPTOOLPY_FLASHSIZE_4MB=y
CONFIG_ESPTOOLPY_FLASHSIZE="4MB"

#
# Compiler options
#
CONFIG_COMPILER_OPTIMIZATION_SIZE=y

#
# ESP System Settings
#
CONFIG_ESP_DEFAULT_CPU_FREQ_MHZ_80=y
CONFIG_ESP_DEFAULT_CPU_FREQ_MHZ=80

#
# FAT Filesystem support
#
CONFIG_FATFS_LFN_STACK=y
CONFIG_FATFS_MAX_LFN=128
CONFIG_FATFS_API_ENCODING_ANSI_OEM=y
CONFIG_FATFS_VFS_FSTAT_BLKSIZE=4096

#
# Kernel
#
CONFIG_FREERTOS_HZ=1000

#
# Ultra Low Power (ULP) Co-processor
#
CONFIG_ULP_COPROC_ENABLED=y
CONFIG_ULP_COPROC_TYPE_FSM=y
CONFIG_ULP_COPROC_RESERVE_MEM=700

# Deprecated options for backward compatibility
CONFIG_OPTIMIZATION_LEVEL_RELEASE=y
CONFIG_COMPILER_OPTIMIZATION_LEVEL_RELEASE=y
CONFIG_ESP32_DEFAULT_CPU_FREQ_80=y
CONFIG_ESP32_DEFAULT_CPU_FREQ_MHZ=80
CONFIG_ESP32_ULP_COPROC_ENABLED=y
CONFIG_ESP32_ULP_COPROC_RESERVE_MEM=700
```

## west.yml
```yaml
# Copyright (c) 2021 Nordic Semiconductor ASA
# SPDX-License-Identifier: Apache-2.0

manifest:
  # self:
  #   west-commands: code/ncs-example-applicationfirmware/zephyr/module.yml

  remotes:
    - name: ncs
      url-base: https://github.com/nrfconnect

  projects:
    - name: nrf
      remote: ncs
      repo-path: sdk-nrf
      revision: main
      import: true
      revision: main #v3.1.0
      clone-depth: 1
```
